## configs/qemu_x86_GL_defconfig
```kconfig
# Architecture
BR2_i386=y
BR2_x86_i686=y

# System
BR2_SYSTEM_DHCP="eth0"
BR2_TARGET_GENERIC_GETTY_PORT="tty1"

# Filesystem
BR2_TARGET_ROOTFS_EXT2=y
BR2_TARGET_ROOTFS_EXT2_3=y
BR2_TARGET_ROOTFS_TAR=y

# Linux headers same as kernel, a 4.13 series
#BR2_PACKAGE_HOST_LINUX_HEADERS_CUSTOM_4_13=y

BR2_DEFAULT_KERNEL_VERSION="4.13"
BR2_KERNEL_HEADERS_VERSION=y
BR2_PACKAGE_HOST_LINUX_HEADERS_CUSTOM_4_13=y

# Kernel
#BR2_LINUX_KERNEL=y
#BR2_LINUX_KERNEL_CUSTOM_VERSION=y
#BR2_LINUX_KERNEL_CUSTOM_VERSION_VALUE="4.16.7"
#BR2_LINUX_KERNEL_USE_CUSTOM_CONFIG=y
#BR2_LINUX_KERNEL_CUSTOM_CONFIG_FILE="board/qemu/x86/linux.config"


BR2_TOOLCHAIN_BUILDROOT_GLIBC=y
BR2_TOOLCHAIN_BUILDROOT_CXX=y
BR2_TARGET_GENERIC_HOSTNAME=qemu
BR2_TARGET_GENERIC_ISSUE="Welcome to test system"
BR2_TARGET_GENERIC_ROOT_PASSWD="0000"
BR2_ROOTFS_USERS_TABLES="${TOPDIR}/../common_for_fs/userstables/users"
BR2_ROOTFS_OVERLAY="${TOPDIR}/../common_for_fs/root"

BR2_PACKAGE_BUSYBOX_SHOW_OTHERS=y
BR2_PACKAGE_BINUTILS=y
BR2_PACKAGE_BINUTILS_TARGET=y
BR2_PACKAGE_FINDUTILS=y
BR2_PACKAGE_GREP=y
BR2_PACKAGE_SED=y
BR2_PACKAGE_TREE=y

BR2_PACKAGE_LIBZIP=y
BR2_PACKAGE_NCURSES=y
BR2_PACKAGE_READLINE=y
BR2_PACKAGE_DROPBEAR=y
BR2_PACKAGE_WGET=y

BR2_PACKAGE_BASH=y
BR2_PACKAGE_FILE=y
BR2_PACKAGE_SUDO=y
BR2_PACKAGE_WHICH=y

BR2_PACKAGE_KMOD=y
BR2_PACKAGE_KMOD_TOOLS=y
BR2_PACKAGE_RSYSLOG=y

BR2_PACKAGE_MC=y
```
